## board/mscc/sparx5/Kconfig
```kconfig
# SPDX-License-Identifier: (GPL-2.0+ OR MIT)

if TARGET_SPARX5

config SYS_BOARD
	default "sparx5"

config SYS_VENDOR
	default "mscc"

config SYS_SOC
	default "sparx5"

config SYS_CONFIG_NAME
	default "sparx5"

config TEXT_BASE
	default 0x35000000

endif

if TARGET_SPARX5_PCIE_EP

config SYS_BOARD
	default "sparx5"

config SYS_VENDOR
	default "mscc"

config SYS_SOC
	default "sparx5"

config SYS_CONFIG_NAME
	default "sparx5_pcie_ep"

config TEXT_BASE
	default 0x35000000

config SYS_MALLOC_F_LEN
	default 0x400

config SPL_SERIAL
	default y

endif
```

## configs/mchp_lan969x_sram_defconfig
```kconfig
CONFIG_ARM=y
CONFIG_POSITION_INDEPENDENT=y
CONFIG_SYS_INIT_SP_BSS_OFFSET=262144
# CONFIG_ARM64_SUPPORT_AARCH32 is not set
CONFIG_TARGET_LAN969X=y
CONFIG_TFABOOT=y
CONFIG_TEXT_BASE=0
CONFIG_SYS_MALLOC_LEN=0x40000
CONFIG_NR_DRAM_BANKS=3
CONFIG_ENV_SOURCE_FILE="lan969x"
CONFIG_SF_DEFAULT_SPEED=10000000
CONFIG_ENV_SIZE=0x8000
CONFIG_ENV_OFFSET=0x1e0000
CONFIG_ENV_SECT_SIZE=0x8000
CONFIG_DM_GPIO=y
CONFIG_DEFAULT_DEVICE_TREE="lan969x_sr"
CONFIG_DEBUG_UART_BASE=0xe0040200
CONFIG_DEBUG_UART_CLOCK=250000000
CONFIG_DEBUG_UART_BOARD_INIT=y
CONFIG_SYS_LOAD_ADDR=0x100000
CONFIG_TARGET_LAN969X_SRAM=y
CONFIG_DEBUG_UART=y
CONFIG_QSPI_BOOT=y
CONFIG_SD_BOOT=y
CONFIG_BOOTDELAY=3
CONFIG_USE_BOOTARGS=y
CONFIG_BOOTARGS="console=ttyS0,115200 root=/dev/ram0 loglevel=7"
CONFIG_LOGLEVEL=2
CONFIG_CONSOLE_MUX=y
CONFIG_BOARD_TYPES=y
CONFIG_HUSH_PARSER=y
CONFIG_SYS_PROMPT="m => "
CONFIG_CMD_GREPENV=y
CONFIG_CMD_ENV_CALLBACK=y
CONFIG_CMD_ENV_FLAGS=y
CONFIG_CMD_MD5SUM=y
CONFIG_CMD_MEMINFO=y
CONFIG_CMD_MEMTEST=y
CONFIG_SYS_ALT_MEMTEST=y
CONFIG_CMD_BIND=y
CONFIG_CMD_GPIO=y
CONFIG_CMD_GPT=y
CONFIG_CMD_GPT_RENAME=y
CONFIG_CMD_MMC=y
CONFIG_CMD_MTD=y
CONFIG_CMD_PART=y
CONFIG_CMD_SF_TEST=y
CONFIG_CMD_SPI=y
CONFIG_CMD_DHCP=y
CONFIG_CMD_MDIO=y
CONFIG_CMD_PING=y
CONFIG_CMD_TIME=y
CONFIG_CMD_SMC=y
CONFIG_CMD_EXT2=y
CONFIG_CMD_EXT4=y
CONFIG_CMD_MTDPARTS=y
CONFIG_MTDIDS_DEFAULT="nor0=spi0"
CONFIG_OF_LIST="lan969x_sr lan969x_ev23x71a lan969x_ev89p81a lan969x_pcb10001 lan969x_ev09p11a"
CONFIG_DTB_RESELECT=y
CONFIG_MULTI_DTB_FIT=y
CONFIG_ENV_IS_IN_FAT=y
CONFIG_ENV_IS_IN_MMC=y
CONFIG_ENV_IS_IN_SPI_FLASH=y
CONFIG_ENV_SPI_MAX_HZ=8000000
CONFIG_ENV_FAT_DEVICE_AND_PART="0:1"
CONFIG_SYS_RELOC_GD_ENV_ADDR=y
CONFIG_VERSION_VARIABLE=y
CONFIG_NET_RANDOM_ETHADDR=y
# CONFIG_OF_TRANSLATE is not set
CONFIG_CLK=y
CONFIG_MISC=y
CONFIG_MMC_SDHCI=y
CONFIG_MMC_SDHCI_SDMA=y
CONFIG_MMC_SDHCI_ATMEL=y
CONFIG_MTD=y
CONFIG_DM_MTD=y
CONFIG_DM_SPI_FLASH=y
CONFIG_SPI_FLASH_ATMEL=y
CONFIG_SPI_FLASH_MACRONIX=y
CONFIG_SPI_FLASH_SST=y
CONFIG_SPI_FLASH_WINBOND=y
CONFIG_SPI_FLASH_MTD=y
CONFIG_PHY_MICROCHIP=y
CONFIG_MSCC_LAN969X_SWITCH=y
CONFIG_PINCTRL=y
CONFIG_PINCONF=y
CONFIG_PINCTRL_LAN969X=y
CONFIG_DEBUG_UART_SKIP_INIT=y
CONFIG_ATMEL_USART=y
CONFIG_SPI=y
CONFIG_DM_SPI=y
CONFIG_ATMEL_QSPI=y
# CONFIG_EFI_LOADER is not set
```

## configs/mscc_sparx5_pcb13x_emmc_defconfig
```kconfig
CONFIG_ARM=y
CONFIG_COUNTER_FREQUENCY=250000000
CONFIG_ENABLE_ARM_SOC_BOOT0_HOOK=y
CONFIG_TARGET_SPARX5=y
CONFIG_TEXT_BASE=0x00000000
CONFIG_NR_DRAM_BANKS=1
CONFIG_ENV_SOURCE_FILE="sparx5"
CONFIG_ENV_SIZE=0x2000
CONFIG_ENV_OFFSET=0x100000
CONFIG_ENV_SECT_SIZE=0x1000
CONFIG_DEFAULT_DEVICE_TREE="sparx5_pcb135_emmc"
CONFIG_DEBUG_UART_BASE=0x600100000
CONFIG_DEBUG_UART_CLOCK=250000000
CONFIG_DEBUG_UART_BOARD_INIT=y
CONFIG_ENV_OFFSET_REDUND=0x140000
CONFIG_IDENT_STRING="sparx5"
# CONFIG_PSCI_RESET is not set
CONFIG_ARMV8_PSCI=y
CONFIG_ARMV8_PSCI_NR_CPUS=2
CONFIG_SYS_LOAD_ADDR=0x720000000
CONFIG_DEBUG_UART=y
CONFIG_FIT=y
CONFIG_OF_BOARD_SETUP=y
CONFIG_LOGLEVEL=2
CONFIG_BOARD_TYPES=y
CONFIG_BOARD_LATE_INIT=y
CONFIG_HUSH_PARSER=y
CONFIG_CMD_GREPENV=y
CONFIG_CMD_ENV_CALLBACK=y
CONFIG_CMD_ENV_FLAGS=y
CONFIG_CMD_MD5SUM=y
CONFIG_CMD_MEMINFO=y
CONFIG_CMD_MEMTEST=y
CONFIG_SYS_ALT_MEMTEST=y
CONFIG_CMD_BIND=y
CONFIG_CMD_GPIO=y
CONFIG_CMD_GPT=y
CONFIG_CMD_GPT_RENAME=y
CONFIG_CMD_MMC=y
CONFIG_CMD_MTD=y
CONFIG_CMD_PART=y
CONFIG_CMD_SF_TEST=y
CONFIG_CMD_SPI=y
CONFIG_CMD_DHCP=y
CONFIG_CMD_MII=y
CONFIG_CMD_PING=y
CONFIG_CMD_TIME=y
CONFIG_CMD_EXT2=y
CONFIG_CMD_EXT4=y
CONFIG_CMD_EXT4_WRITE=y
CONFIG_CMD_MTDPARTS=y
CONFIG_MTDIDS_DEFAULT="nor0=spi0.0"
CONFIG_MTDPARTS_DEFAULT="mtdparts=spi0.0:1m(UBoot),256k(Env),256k(Env.bk),20m(linux),20m(linux.bk)"
CONFIG_CMD_UBI=y
CONFIG_MMC_SPEED_MODE_SET=y
CONFIG_DOS_PARTITION=y
CONFIG_PARTITION_TYPE_GUID=y
CONFIG_OF_LIST="sparx5_pcb134_emmc sparx5_pcb135_emmc"
CONFIG_DTB_RESELECT=y
CONFIG_MULTI_DTB_FIT=y
CONFIG_ENV_IS_IN_SPI_FLASH=y
CONFIG_ENV_SPI_MAX_HZ=8000000
CONFIG_SYS_REDUNDAND_ENVIRONMENT=y
CONFIG_ENV_VARS_UBOOT_RUNTIME_CONFIG=y
CONFIG_VERSION_VARIABLE=y
CONFIG_NET_RANDOM_ETHADDR=y
# CONFIG_OF_TRANSLATE is not set
CONFIG_CLK=y
CONFIG_MSCC_SGPIO=y
CONFIG_LED=y
CONFIG_LED_GPIO=y
# CONFIG_MMC_VERBOSE is not set
CONFIG_MMC_SDHCI=y
CONFIG_MMC_SDHCI_ADMA=y
CONFIG_MMC_SDHCI_SPARX5=y
CONFIG_MTD=y
CONFIG_DM_SPI_FLASH=y
CONFIG_SPI_FLASH_GIGADEVICE=y
CONFIG_SPI_FLASH_MACRONIX=y
CONFIG_SPI_FLASH_SPANSION=y
CONFIG_SPI_FLASH_STMICRO=y
CONFIG_SPI_FLASH_SST=y
CONFIG_SPI_FLASH_WINBOND=y
CONFIG_SPI_FLASH_MTD=y
CONFIG_MTD_UBI_FASTMAP=y
CONFIG_PHY_MICROCHIP=y
CONFIG_PHY_MSCC=y
CONFIG_PHY_VITESSE=y
CONFIG_PHY_GIGE=y
CONFIG_MSCC_SPARX5_SWITCH=y
CONFIG_PINCTRL=y
CONFIG_PINCONF=y
CONFIG_DEBUG_UART_SHIFT=2
CONFIG_SYS_NS16550_MEM32=y
CONFIG_SPI=y
CONFIG_DM_SPI=y
CONFIG_DESIGNWARE_SPI=y
# CONFIG_EFI_LOADER is not set
```

## configs/mscc_sparx5_pcb13x_pciep_defconfig
```kconfig
CONFIG_ARM=y
CONFIG_SKIP_LOWLEVEL_INIT=y
CONFIG_SPL_SKIP_LOWLEVEL_INIT=y
CONFIG_SYS_ARCH_TIMER=y
# CONFIG_SPL_USE_ARCH_MEMCPY is not set
# CONFIG_SPL_USE_ARCH_MEMSET is not set
CONFIG_TEXT_BASE=0x00000000
CONFIG_SPL_LIBGENERIC_SUPPORT=y
CONFIG_COUNTER_FREQUENCY=250000000
CONFIG_ENABLE_ARM_SOC_BOOT0_HOOK=y
CONFIG_TARGET_SPARX5_PCIE_EP=y
CONFIG_SPECIFY_CONSOLE_INDEX=y
CONFIG_SPL=y
CONFIG_SPL_SYS_MALLOC_SIMPLE=y
CONFIG_SPL_NO_BSS_LIMIT=y
CONFIG_SPL_SEPARATE_BSS=y
CONFIG_DEBUG_UART_BASE=0x600100000
CONFIG_DEBUG_UART_CLOCK=250000000
CONFIG_DEBUG_UART_BOARD_INIT=y
CONFIG_SYS_LOAD_ADDR=0x0
CONFIG_DEBUG_UART=y
# CONFIG_SPL_FRAMEWORK is not set
# CONFIG_SPL_BANNER_PRINT is not set
CONFIG_DEBUG_UART_ANNOUNCE=y
CONFIG_SYS_NS16550=y
CONFIG_DEBUG_UART_SHIFT=2
CONFIG_SYS_NS16550_MEM32=y
CONFIG_SPL_TINY_MEMSET=y
CONFIG_BOARD_EARLY_INIT_F=y
```
